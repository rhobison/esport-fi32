## main/Kconfig.projbuild
```kconfig
menu "esport-fi32 Configuration"

    config ESPORT_PULSE_GPIO
        int "Pulse input GPIO number"
        default 10
        range 0 30
        help
            GPIO number connected to the bike sensor pulse output.
            Valid pulses are detected on the falling edge
            (sensor contact closes to GND).  Build-time constant;
            cannot be changed at runtime.

    config ESPORT_PULSE_PULLUP_EN
        int "Enable internal pull-up on pulse input GPIO (0=disable, 1=enable)"
        range 0 1
        default 1
        help
            Set to 1 to activate the ESP32 internal pull-up resistor on the
            pulse input GPIO pin.  Set to 0 when an external pull-up is
            already present on the board.

    config ESPORT_PULSE_PULLDOWN_EN
        int "Enable internal pull-down on pulse input GPIO (0=disable, 1=enable)"
        range 0 1
        default 0
        help
            Set to 1 to activate the ESP32 internal pull-down resistor on
            the pulse input GPIO pin.  Should not be set to 1 at the same
            time as the pull-up option.

    config ESPORT_WIFI_SSID
        string "Home Wi-Fi SSID"
        default ""
        help
            SSID of the home network the device connects to as a station.
            Leave empty to skip STA connection (the reward AP remains
            available for configuration at 192.168.5.1).
            Maximum 32 characters.  Build-time default; can be overridden
            at runtime via the web configuration portal (stored in NVS).

    config ESPORT_WIFI_PASSWORD
        string "Home Wi-Fi Password"
        default ""
        help
            WPA2 password for the home network.  Leave empty for open
            networks.  Maximum 64 characters.  Build-time default; can be
            overridden at runtime via the web configuration portal
            (stored in NVS).

    config ESPORT_REWARD_AP_SSID
        string "Reward SoftAP SSID"
        default "esport-fi32"
        help
            SSID of the reward access point enabled when the time counter
            reaches the threshold.  Maximum 32 characters.  Build-time
            default; can be overridden at runtime via the web configuration
            portal (stored in NVS).

    config ESPORT_REWARD_AP_PASSWORD
        string "Reward SoftAP Password"
        default "esport-fi32"
        help
            WPA2 password for the reward access point.  Maximum 64
            characters.  Build-time default; can be overridden at runtime
            via the web configuration portal (stored in NVS).

    config ESPORT_AP_THRESHOLD_KBPS
        int "Reward AP idle throughput threshold (kbps)"
        range 0 65535
        default 5
        help
            Combined RX+TX throughput (kbps) on the reward AP below which
            the countdown is considered idle and may pause.

    config ESPORT_AP_IDLE_TIMEOUT_S
        int "Reward AP idle throughput timeout (seconds)"
        range 0 65535
        default 30
        help
            Number of consecutive seconds that throughput must remain below
            the threshold before the countdown pauses.  Set to 0 to pause
            on the very first below-threshold tick.

    config ESPORT_MIN_SPEED_KMH_X10
        int "Minimum speed to earn time credits (km/h x10)"
        range 0 65535
        default 30
        help
            Minimum instantaneous speed in km/h x10 required for a pulse to
            earn time credits.  A value of 30 represents 3.0 km/h.  Set to 0
            to disable the gate and credit all pulses regardless of speed.

    config ESPORT_BUZZER_GPIO
        int "Buzzer GPIO number"
        range 0 21
        default 11
        help
            GPIO number connected to the active buzzer.  The buzzer is driven
            HIGH when on, LOW when off.  Build-time constant; cannot be
            changed at runtime.

endmenu
```
